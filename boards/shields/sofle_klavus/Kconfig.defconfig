## boards/shields/sofle_klavus/Kconfig.defconfig
```kconfig
if SHIELD_SOFLE_KLAVUS_LEFT

# Name must be less than 16 characters long!
config ZMK_KEYBOARD_NAME
    default "Sofle Klavus"

config ZMK_SPLIT_ROLE_CENTRAL
    default y

endif

if SHIELD_SOFLE_KLAVUS_LEFT || SHIELD_SOFLE_KLAVUS_RIGHT

config ZMK_SPLIT
    default y

if ZMK_DISPLAY

config I2C
    default y

config SSD1306
    default y

endif # ZMK_DISPLAY

if LVGL

config LV_Z_VDB_SIZE
    default 64

config LV_DPI_DEF
    default 148

config LV_Z_BITS_PER_PIXEL
    default 1

choice LV_COLOR_DEPTH
    default LV_COLOR_DEPTH_1
endchoice

endif # LVGL

if ZMK_RGB_UNDERGLOW

config WS2812_STRIP
    default y
endif

endif
```

## boards/shields/sofle_klavus/Kconfig.shield
```kconfig
config SHIELD_SOFLE_KLAVUS_DONGLE
    def_bool $(shields_list_contains,sofle_klavus_dongle)

config SHIELD_SOFLE_KLAVUS_LEFT
    def_bool $(shields_list_contains,sofle_klavus_left)

config SHIELD_SOFLE_KLAVUS_RIGHT
    def_bool $(shields_list_contains,sofle_klavus_right)
```
